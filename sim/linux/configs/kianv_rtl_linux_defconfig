## sim/linux/configs/kianv_rtl_linux_defconfig
```kconfig
BR2_riscv=y
BR2_riscv_custom=y
BR2_RISCV_ISA_RVM=y
BR2_RISCV_ISA_RVA=y
BR2_RISCV_32=y
BR2_GCC_VERSION_13_X=y
BR2_CCACHE=y
BR2_CCACHE_DIR="$(TOPDIR)/../ccache"
BR2_OPTIMIZE_S=y
BR2_GLOBAL_PATCH_DIR="board/kianv/rv32ima_sv32/patches"
BR2_INIT_NONE=y
BR2_ROOTFS_OVERLAY="board/kianv/rtl-sim/rootfs-overlay"
BR2_LINUX_KERNEL=y
BR2_LINUX_KERNEL_CUSTOM_VERSION=y
BR2_LINUX_KERNEL_CUSTOM_VERSION_VALUE="7.1-rc1"
BR2_LINUX_KERNEL_USE_CUSTOM_CONFIG=y
BR2_LINUX_KERNEL_CUSTOM_CONFIG_FILE="board/kianv/rv32ima_sv32/linux.config"
BR2_LINUX_KERNEL_CONFIG_FRAGMENT_FILES="board/kianv/rtl-sim/linux-sim.fragment"
BR2_PACKAGE_BUSYBOX=y
BR2_TARGET_ROOTFS_INITRAMFS=y
BR2_TARGET_OPENSBI=y
BR2_TARGET_OPENSBI_CUSTOM_VERSION=y
BR2_TARGET_OPENSBI_CUSTOM_VERSION_VALUE="1.4"
BR2_TARGET_OPENSBI_PLAT="fpga/kianv"
# BR2_TARGET_OPENSBI_INSTALL_DYNAMIC_IMG is not set
# BR2_TARGET_OPENSBI_INSTALL_JUMP_IMG is not set
BR2_TARGET_OPENSBI_LINUX_PAYLOAD=y
BR2_TARGET_OPENSBI_ADDITIONAL_VARIABLES="BUILD_INFO=y PLATFORM_RISCV_XLEN=32 PLATFORM_RISCV_ABI=ilp32 PLATFORM_RISCV_ISA=rv32ima_zicsr_zifencei FW_FDT_PATH=$(TOPDIR)/board/kianv/rv32ima_sv32/kianv.dtb"
```
